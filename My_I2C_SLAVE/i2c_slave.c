#include "i2c_slave.h"
#include "dol.h"
#define REQUEST	0x12//ключевое слово запроса

#define  TH0_VAL 0x0
#define  TL0_VAL 0x0
#define WATCH_I2C	30

sbit FL1=P2^0;
sbit FL2=P2^1;
volatile unsigned char test_buf[15]={0x1,0x2,0x3,0x4,0x5,0x6,0x7,0x8,0x9,0xA,0xB,0xC,0xD,0xE,0xF};
//--------------------------------------------------------
  unsigned char code Crc8Table[256]={0x00, 0xBC, 0x01, 0xBD, 0x02, 0xBE, 0x03, 0xBF, 
 									 0x04, 0xB8, 0x05, 0xB9, 0x06, 0xBA, 0x07, 0xBB, 
									 0x08, 0xB4, 0x09, 0xB5, 0x0A, 0xB6, 0x0B, 0xB7, 
									 0x0C, 0xB0, 0x0D, 0xB1, 0x0E, 0xB2, 0x0F, 0xB3, 
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									 0x7C, 0xC0, 0x7D, 0xC1, 0x7E, 0xC2, 0x7F, 0xC3};
//--------------------------------------------------------
volatile unsigned char req=0;
volatile unsigned char count=0;
volatile unsigned char watch_timer=WATCH_I2C;//следящий за зависанием таймер

//--------------------------------------------------------
void I2C_Slave_Init(void) //инициализация узла i2c slave
{
	I2CCON=0x00; // ведомый
	I2CADD=0x58;
	IEIP2|=0x1; // разрешение прерывания от I2C	
	channels.transfer=0;
	//----------------------------------	
	TMOD &= 0xF0; // 1111 0000 
	TMOD |= 0x1; // 16 bit timer-watcdog

	TH0	= TH0_VAL; /// 
	TL0 = TL0_VAL;//
	watch_timer=WATCH_I2C;

	ET0=1;
	TR0=1;

	channels.I2C_CHNL.channels.state_byte=0xC0;
	//----------------------------------
	return;
}
//--------------------------------------------------------
void I2C_ISR(void) interrupt 7//прерывание I2C
{
	if(I2CTX==0)  //прием
	{ 
		req=I2CDAT;
		

		FL1=channels.I2C_CHNL.channels.state_byte&0x80;

		channels.I2C_CHNL.channels.DOL=channels.DOL_buf;//копируем данные дола
		channels.I2C_CHNL.channels.frequency=channels.frequency_buf;
		channels.I2C_CHNL.channels.mid_frequency=channels.mid_frequency_buf;
						 
				

		count=0;
		//channels.transfer=1;

		watch_timer=WATCH_I2C; //сброс сторожевого таймера
		TH0	= TH0_VAL; /// 
		TL0 = TL0_VAL;//
		
		switch(req)
		{
			case SLAVE_STATE_BYTE_RESET:
			{
				channels.I2C_CHNL.channels.state_byte=0x40;//сброс байта статуса	
			}
			break;

			case SLAVE_DOL_COUNT_RESET:
			{
				Dol_Init();
			}
			break;

			default:
			{
			}
			break;
		}
	}
	else   //передача
	{
		if(count<I2C_FRAME_SIZE)
		{		
			I2CDAT=channels.I2C_CHNL.i2c_buf[count];
			count++;
			
			if(count==(I2C_FRAME_SIZE-1))
			{
				channels.I2C_CHNL.channels.CRC=CRC_Check(channels.I2C_CHNL.i2c_buf,I2C_FRAME_SIZE-1);
				//channels.transfer=0;
			}
		}
	}
	return;
}
//--------------------------------------------------------
void Timer0_ISR(void) interrupt 1
{
	TF0=0;
	TH0	= TH0_VAL; /// 
	TL0 = TL0_VAL;//
	watch_timer--;

	if(watch_timer==0)
	{
		I2CRS=1;
		I2CRS=0;
		watch_timer=WATCH_I2C;
		
	}
	return;
}
//-----------------------CRC------------------------------------------------------------
  unsigned char CRC_Check( unsigned char xdata *Spool_pr,unsigned char Count_pr ) 
 {

     unsigned char crc = 0x0;

     while (Count_pr--)
         crc = Crc8Table[crc ^ *Spool_pr++];

     return crc;

 }

//-----------------------------------------------------------------------------------------------